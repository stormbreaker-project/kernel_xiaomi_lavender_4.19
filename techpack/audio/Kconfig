## techpack/audio/Kconfig
```kconfig
config PINCTRL_LPI
	tristate "PINCTRL_LPI"

config PINCTRL_WCD
	tristate "PINCTRL_WCD"

config AUDIO_EXT_CLK
	tristate "AUDIO_EXT_CLK"

config SND_SOC_WCD9XXX_V2
	tristate "SND_SOC_WCD9XXX_V2"

config SND_SOC_WCD_MBHC
	tristate "SND_SOC_WCD_MBHC"

config SND_SOC_WSA881X
	tristate "SND_SOC_WSA881X"

config SND_SOC_WCD_DSP_MGR
	tristate "SND_SOC_WCD_DSP_MGR"

config SND_SOC_WCD_SPI
	tristate "SND_SOC_WCD_SPI"

config SND_SOC_WCD_CPE
	tristate "SND_SOC_WCD_CPE"

config SND_SOC_CPE
	tristate "SND_SOC_CPE"

config SND_SOC_WCD9335
	tristate "SND_SOC_WCD9335"

config SND_SOC_WCD934X
	tristate "SND_SOC_WCD934X"

config SND_SOC_WCD934X_MBHC
	tristate "SND_SOC_WCD934X_MBHC"

config SND_SOC_WCD934X_DSD
	tristate "SND_SOC_WCD934X_DSD"

config MSM_QDSP6V2_CODECS
	tristate "MSM_QDSP6V2_CODECS"

config MSM_ULTRASOUND
	tristate "MSM_ULTRASOUND"

config MSM_QDSP6_APRV2_RPMSG
	tristate "MSM_QDSP6_APRV2_RPMSG"

config MSM_ADSP_LOADER
	tristate "MSM_ADSP_LOADER"

config REGMAP_SWR
	tristate "REGMAP_SWR"

config MSM_QDSP6_SSR
	tristate "MSM_QDSP6_SSR"

config MSM_QDSP6_PDR
	tristate "MSM_QDSP6_PDR"

config MSM_QDSP6_NOTIFIER
	tristate "MSM_QDSP6_NOTIFIER"

config SND_SOC_MSM_HOSTLESS_PCM
	tristate "SND_SOC_MSM_HOSTLESS_PCM"

config SND_SOC_MSM_QDSP6V2_INTF
	tristate "SND_SOC_MSM_QDSP6V2_INTF"

config SND_SOC_SDM660
	tristate "SND_SOC_SDM660"

config MSM_GLINK_SPI_XPRT
	tristate "MSM_GLINK_SPI_XPRT"

config SOUNDWIRE
	tristate "SOUNDWIRE"

config SOUNDWIRE_WCD_CTRL
	tristate "SOUNDWIRE_WCD_CTRL"

config SND_SOC_QDSP6V2
	tristate "SND_SOC_QDSP6V2"

config WCD9XXX_CODEC_CORE
	tristate "WCD9XXX_CODEC_CORE"

config MSM_CDC_PINCTRL
	tristate "MSM_CDC_PINCTRL"

config SND_SOC_WCD_MBHC_ADC
	tristate "SND_SOC_WCD_MBHC_ADC"

config SND_SOC_WCD_MBHC_LEGACY
	tristate "SND_SOC_WCD_MBHC_LEGACY"

config QTI_PP
	tristate "QTI_PP"

config SND_HWDEP_ROUTING
	tristate "SND_HWDEP_ROUTING"

config DTS_EAGLE
	tristate "DTS_EAGLE"

config DOLBY_DS2
	tristate "DOLBY_DS2"

config DOLBY_LICENSE
	tristate "DOLBY_LICENSE"

config DTS_SRS_TM
	tristate "DTS_SRS_TM"

config SND_SOC_EXT_CODEC
	tristate "SND_SOC_EXT_CODEC"

config SND_SOC_INT_CODEC
	tristate "SND_SOC_INT_CODEC"

config SND_SOC_MSM_STUB
	tristate "SND_SOC_MSM_STUB"

config WCD_DSP_GLINK
	tristate "WCD_DSP_GLINK"

config AVTIMER_LEGACY
	tristate "AVTIMER_LEGACY"
	depends on MSMB_CAMERA
	depends on MSM_AVTIMER

config SND_SOC_SDM660_CDC
	tristate "SND_SOC_SDM660_CDC"

config SND_SOC_ANALOG_CDC
	tristate "SND_SOC_ANALOG_CDC"

config SND_SOC_DIGITAL_CDC
	tristate "SND_SOC_DIGITAL_CDC"

config SND_SOC_MSM_SDW
	tristate "SND_SOC_MSM_SDW"

config SND_SOC_MSM_HDMI_CODEC_RX
	tristate "SND_SOC_MSM_HDMI_CODEC_RX"

config SND_SOC_TAS2557
	tristate "Texas Instruments TAS2557 SmartAmp(R)"

if SND_SOC_TAS2557
config TAS2557_REGMAP
	bool "Use of RegMap API"

config TAS2557_CODEC
	bool "Codec Driver support"

config TAS2557_MISC
	bool "Misc Driver support"
endif # SND_SOC_TAS2557

config SND_I2S_PRIMARY
	bool "Primary I2S Driver support"

config SND_SOC_MAX98937
	tristate "maxim Instruments 98937 SmartAmp(R)"

config ELLIPTICLABS
	tristate "Elliptic Labs fake proximity sensor support"
```
